## kernel/arch/arm/mach-rockchip/Kconfig
```kconfig
config ARCH_ROCKCHIP
	bool "Rockchip RK2928 and RK3xxx SOCs"
	depends on ARCH_MULTI_V7
	select PINCTRL
	select PINCTRL_ROCKCHIP
	select ARCH_HAS_RESET_CONTROLLER
	select ARM_AMBA
	select ARM_GIC
	select CACHE_L2X0 if (CPU_RK30XX || CPU_RK3188)
	select GPIOLIB
	select HAVE_ARM_ARCH_TIMER
	select HAVE_ARM_SCU if SMP
	select HAVE_ARM_TWD if SMP && (CPU_RK30XX || CPU_RK3188)
	select DW_APB_TIMER_OF if CPU_RK30XX
	select REGULATOR if PM
	select ROCKCHIP_TIMER
	select ARM_GLOBAL_TIMER if (CPU_RK30XX || CPU_RK3188)
	select CLKSRC_ARM_GLOBAL_TIMER_SCHED_CLOCK if (CPU_RK30XX || CPU_RK3188)
	select ZONE_DMA if ARM_LPAE
	select PM
	help
	  Support for Rockchip's Cortex-A9 Single-to-Quad-Core-SoCs
	  containing the RK2928, RK30xx and RK31xx series.

config RK_PROBE_DECOMP
	bool "PROBE A: write rockusb flag and CRU reset at decompressor entry (debug only)"
	depends on ARCH_ROCKCHIP
	help
	  Bisection probe. Enters a spin loop after a CRU global soft reset
	  with the loader flag set. Board re-enumerates as rockusb 2207:0011
	  only if U-Boot jumped into this zImage. Never a production setting.

config RK_PROBE_KERNEL_ENTRY
	bool "PROBE C: write rockusb flag and CRU reset at ENTRY(stext) (debug only)"
	depends on ARCH_ROCKCHIP
	help
	  Bisection probe. Runs in arch/arm/kernel/head.S right after
	  safe_svcmode_maskall, with the MMU still off (physical addresses).
	  Writes the loader flag, issues a CRU global soft reset, then spins.
	  Never a production setting.

config RK_PROBE_SETUP_ARCH
	bool "PROBE D: write rockusb flag and CRU reset at end of setup_arch (debug only)"
	depends on ARCH_ROCKCHIP
	help
	  Bisection probe. Runs at the end of setup_arch(), after paging_init()
	  and init_early(), with the MMU and kernel mappings live. Maps PMU and
	  CRU with ioremap(), writes the loader flag, issues a CRU global soft
	  reset, then spins. Never a production setting.

config RK_PROBE_FDT_MAGIC
	bool "PROBE E1: checkpoint at stext only if r2 holds a valid FDT magic (debug only)"
	depends on ARCH_ROCKCHIP
	help
	  Bisection probe. Same location as PROBE C (ENTRY(stext) after
	  safe_svcmode_maskall). Reads the 32-bit word at the address in r2
	  (little-endian); if it equals 0xedfe0dd0 (FDT magic) it writes the
	  loader flag and issues a CRU global soft reset, otherwise it spins.
	  Never a production setting.

config RK_PROBE_PRE_MMU
	bool "PROBE E2: write rockusb flag and CRU reset just before MMU enable (debug only)"
	depends on ARCH_ROCKCHIP
	help
	  Bisection probe. Runs in __turn_mmu_on (.idmap.text) immediately
	  before the SCTLR write that turns the MMU on, so the MMU is still
	  off and physical addresses are used. Writes the loader flag, issues
	  a CRU global soft reset, then spins. Never a production setting.

config RK_PROBE_AFTER_MM
	bool "PROBE F3: write rockusb flag and CRU reset after mm_init() in start_kernel (debug only)"
	depends on ARCH_ROCKCHIP
	help
	  Bisection probe. Runs in start_kernel() right after mm_init(), when
	  vmalloc is ready. Maps PMU and CRU with ioremap(), writes the loader
	  flag, issues a CRU global soft reset, then spins. If either mapping
	  fails, boot continues. Never a production setting.

config RK_PROBE_EARLY_IOREMAP
	bool "PROBE F1: write rockusb flag and CRU reset after early_ioremap_init() (debug only)"
	depends on ARCH_ROCKCHIP
	help
	  Bisection probe. Runs in setup_arch() right after early_ioremap_init(),
	  maps PMU and CRU with early_ioremap(), writes the loader flag, issues a
	  CRU global soft reset, then spins. If either mapping fails, boot
	  continues. Never a production setting.

config RK_PROBE_PRE_PAGING
	bool "PROBE F2: write rockusb flag and CRU reset before paging_init() (debug only)"
	depends on ARCH_ROCKCHIP
	help
	  Bisection probe. Runs in setup_arch() before early_ioremap_reset() and
	  paging_init(), maps PMU and CRU with early_ioremap(), writes the loader
	  flag, issues a CRU global soft reset, then spins. If either mapping
	  fails, boot continues. Never a production setting.

config RK_PROBE_POINTS
	bool "Numbered checkpoint probes selected by rkprobe= (debug only)"
	depends on ARCH_ROCKCHIP
	default n
	help
	  Bisection probes. rk_probe_point(n) is compiled into start_kernel(),
	  kernel_init_freeable(), do_initcalls() and kernel_init(). With
	  "rkprobe=N" on the command line, the kernel writes the rockusb loader
	  flag, issues a CRU global soft reset and spins at checkpoint N.
	  Never a production setting.

config RK_PANIC_TO_LOADER
	bool "Write the rockusb loader flag on panic so the board returns to USB"
	depends on ARCH_ROCKCHIP
	default n
	help
	  Registers a panic notifier (highest priority) that writes
	  0x5242C301 to PMU_SYS_REG0 (0xFF730094). panic() then reboots
	  through the restart path, and the boot ROM re-enters rockusb
	  instead of booting this kernel again. Diagnostic builds only.

config RK_WDT_GUARD
	bool "Arm the RK3288 watchdog in the decompressor and set rockusb loader flag"
	depends on ARCH_ROCKCHIP
	help
	  Ungate the RK3288 watchdog pclk (SGRF_SOC_CON0 bit6/bit1) and start
	  the always-on (PMU domain) watchdog in the first instructions of the
	  decompressor stub (top=15), then set the PMU loader reboot flag so
	  that the reset it issues re-enters the rockusb USB download mode
	  instead of booting normally.

	  The timeout is 2^(top+16) / pclk_wdt, with pclk_wdt =
	  pclk_pd_alive = gpll / DIV(CLKSEL_CON(33)[12:8]). It is NOT a fixed
	  89s: 89s is what you get if pclk_wdt happens to be 24MHz.

	  Nothing in the kernel feeds this watchdog and the DTB wdt node is
	  left disabled, so it expires unless the board is reset first. This
	  is meant for unattended boards that must stay recoverable after a
	  kernel hang. Say N unless you know exactly what you are doing.

config RK_WDT_GUARD_EMU
	bool "Relocate the RK_WDT_GUARD registers into QEMU virt RAM (EMULATION ONLY)"
	depends on RK_WDT_GUARD
	help
	  QEMU's "-M virt" machine has no RK3288 PMU/alive register block:
	  0xff800000 and 0xff730000 are not mapped, so a guest that executes
	  the RK_WDT_GUARD stores in the decompressor takes an external abort
	  before it can print anything.

	  This option (and only this option) moves those stores - and the
	  ioremap() base used by drivers/soc/rockchip/rk_wdt_guard.c - to plain
	  RAM inside the virt machine:

		0x4ff80000  watchdog TORR/CRR/CR   (was 0xff800000)
		0x4ff73000  PMU loader flag        (was 0xff730000)

	  Nothing then acts as a real watchdog: the writes are just observable
	  memory traffic, which is exactly what an emulation harness needs in
	  order to timestamp arming, petting and the expiry that a host-side
	  supervisor turns into a reset. There is no hardware behind these
	  addresses, so feeding them does not keep anything alive.

	  EMULATION ONLY. On a real RK3288 this points the decompressor at DRAM
	  and the SoC watchdog is never armed, so the board loses the reset-to-
	  rockusb safety net. It MUST be off in every real-hardware build.

config RK_WDT_BACKSTOP
	bool "RK3288 hardware watchdog backstop (hard-hang -> system reset)"
	depends on ARCH_ROCKCHIP
	default n
	help
	  Arm the SoC watchdog (0xff800000) from start_kernel() right after
	  time_init(), ungate its pclk via SGRF_SOC_CON0 bit6 (write-mask bit22),
	  and kick it from an SCHED_FIFO kthread every second. A hard hang that
	  stops the kthread turns into a system reset after the timeout, which
	  keeps DRAM (ramoops console log survives).

	  Timeout = (2^(16+TOP)-1) / pclk_wdt, pclk_wdt = pclk_pd_alive (unmeasured).
	  Boot parameters: rkwdt=0 disables, rkwdt_top=N sets TOP (0..15, default
	  13), rkwdt_test=1 spins with IRQs off and no kicks at checkpoint 1.
```

## kernel/drivers/devfreq/rockchip/Kconfig
```kconfig
config ARM_RK3288_DMC_DEVFREQ
	tristate "ARM RK3288 DMC DEVFREQ Driver (trust-free, ChromeOS)"
	depends on ARCH_ROCKCHIP && ARM && !CPU_BIG_ENDIAN
	select PM_OPP
	select DEVFREQ_GOV_USERSPACE
	help
	  This adds the DEVFREQ driver for the RK3288 dmc ported from the
	  ChromeOS 4.19 kernel. The DDR frequency is changed by code copied
	  into on-chip SRAM, without any secure firmware (no SIP calls).

	  The driver registers with the "userspace" governor and never changes
	  the DDR frequency on its own: the rate the bootloader left stays in
	  place until userspace writes devfreq's set_freq.

	  The display sync (dmc-sync, VOP hook), the SRAM blob and the MMU-off
	  call helper are always built in when this is enabled; they stay inert
	  until the driver registers. With M, the drivers are the modules
	  clk-rk3288-dmc and rk3288_dmc (load in that order); they cannot be
	  unloaded.
```

## kernel/drivers/soc/rockchip/Kconfig
```kconfig
if ARCH_ROCKCHIP || COMPILE_TEST

source "drivers/soc/rockchip/Kconfig.cpu"

#
# Rockchip Soc drivers
#

config ANDROID_VERSION
	hex "Android Version"
	depends on ANDROID
	default "0x08010000"
	help
	  The version of Android kernel supported.
	  The value is 0xAABBCCRR, corresponding to Android A.B.C release R

config ROCKCHIP_AMP
	tristate "Rockchip AMP support"
	help
	  Say y here to enable Rockchip AMP support.
	  This option protects resources used by AMP.

config ROCKCHIP_CPUINFO
	tristate "Rockchip cpuinfo support"
	depends on (ROCKCHIP_EFUSE || ROCKCHIP_OTP) && (ARM64 || ARM)
	default y
	help
	  Say y here to enable Rockchip cpuinfo support.
	  Set system_serial_low/high from eFuse ID.
	  Serial can read from /proc/cpuinfo.

	  If unsure, say N.

config ROCKCHIP_GRF
	tristate "Rockchip General Register Files support"
	default y
	help
	  The General Register Files are a central component providing
	  special additional settings registers for a lot of soc-components.
	  In a lot of cases there also need to be default settings initialized
	  to make some of them conform to expectations of the kernel.

config ROCKCHIP_HW_DECOMPRESS
	bool "Rockchip HardWare Decompress Support"
	help
	  This driver support Decompress IP built-in Rockchip SoC, support
	  LZ4, GZIP, ZLIB.

config ROCKCHIP_IPA
	tristate "Rockchip IPA support"
	depends on THERMAL && OF
	default y
	help
	  Say y here to enable rockchip IPA.
	  Add a simple power model for ipa to calculate static power and
	  dynamic power.

	  If unsure, say N.

config ROCKCHIP_OPP
	tristate "Rockchip OPP select support"
	depends on PM_DEVFREQ
	default y
	help
	  Say y here to enable rockchip OPP support.

config ROCKCHIP_PM_DOMAINS
        tristate "Rockchip generic power domain"
        depends on PM
        select PM_GENERIC_DOMAINS
        help
          Say y here to enable power domain support.
          In order to meet high performance and low power requirements, a power
          management unit is designed or saving power when RK3288 in low power
          mode. The RK3288 PMU is dedicated for managing the power of the whole chip.

          If unsure, say N.

config ROCKCHIP_PVTM
	tristate "Rockchip PVTM support"
	help
	  Say y here to enable pvtm support.
	  The Process-Voltage-Temperature Monitor (PVTM) is used to monitor
	  the chip performance variance caused by chip process, voltage and
	  temperature.

config ROCKCHIP_RAMDISK
	bool "Rockchip RAM disk support"
	help
	  Saying Y here will allow you to use reserved RAM memory as a block
	  device.

config ROCKCHIP_SUSPEND_MODE
	tristate "Rockchip suspend mode config"
	depends on ROCKCHIP_SIP
	help
	  Say Y here if you want to set the suspend mode to the ATF.

config ROCKCHIP_SYSTEM_MONITOR
	tristate "Rockchip system monitor support"
	default y
	help
	  Say y here to enable rockchip system monitor support.

config ROCKCHIP_MTD_VENDOR_STORAGE
	bool "Rockchip mtd vendor storage support"
	depends on MTD
	default y
	help
	  Say y here to enable rockchip mtd vendor storage support.

config ROCKCHIP_VENDOR_STORAGE_UPDATE_LOADER
	bool "Rockchip vendor storage update loader support"
	default n
	help
	  Say y here to enable rockchip vendor storage update loader support.
	  The /dev/vendor_storage must set root user access only.

config ROCKCHIP_DEBUG
	tristate "Rockchip DEBUG"
	default y
	help
	  Print dbgpcsr for every cpu when panic.

config ROCKCHIP_LOW_PERFORMANCE
	bool "Rockchip low performance support"
	help
	  Say y here to enable Rockchip low performance support.
	  This option make the SoC low power.

config ROCKCHIP_THUNDER_BOOT
	bool "Rockchip Thunder Boot support"
	help
	  Say y here to enable Rockchip thunder boot support.
	  This option make the kernel boot faster.

config ROCKCHIP_THUNDER_BOOT_MMC
	bool "Rockchip Thunder Boot from MMC"
	depends on ROCKCHIP_THUNDER_BOOT
	help
	  Say y if boot from MMC.

config ROCKCHIP_THUNDER_BOOT_SFC
	bool "Rockchip Thunder Boot from SFC"
	depends on ROCKCHIP_THUNDER_BOOT
	help
	  Say y if boot from SPI Flash from SFC controller.

config ROCKCHIP_THUNDER_BOOT_CRYPTO
	bool "Rockchip Thunder Boot support hardware crypto"
	depends on ROCKCHIP_THUNDER_BOOT
	help
	  Say y if boot need hardware crypto.

config ROCKCHIP_SCHED_PERFORMANCE_BIAS
	bool "Rockchip task scheduler optimization"
	depends on SMP && CPU_FREQ_GOV_INTERACTIVE
	default y
	help
	  Say y here to enable rockchip optimize task scheduler for performance bias,
	  this would cause a little more power consumption.

endif

config RK_PROBE_LATE
	bool "PROBE B: write rockusb flag and CRU reset at late_initcall_sync (debug only)"
	depends on ARCH_ROCKCHIP
	help
	  Bisection probe. Normal boot until late_initcall_sync, then sets the
	  loader flag and issues a CRU global soft reset. Rockusb re-enumeration
	  proves the kernel survived all earlier driver init. Never a production setting.

config RK_LOGDUMP
	bool "Dump kernel log to kpanic partition"
	depends on BLOCK
	default n
	help
	  Provides rk_logdump_to_kpanic(), which writes the printk ring buffer
	  and a reason string to the 4 MiB "kpanic" partition in RKLOGDP1
	  format, so the host can read it back after a forced reset.
	  If PSTORE_RAM is built in, the dump also carries the raw ramoops
	  region and the previous boot's console (RKRAMOP1/RKPREVC1 sections).
	  The rklogdump_test=<N> parameter calls it at uptime N seconds
	  without resetting (for QEMU testing); rklogdump_restart=1 and
	  rklogmark=<str> are QEMU two-boot test hooks.

config RK_LOGDUMP_PERIOD_DEFAULT
	int "Default rklogdump_period (seconds, 0 = off)"
	depends on RK_LOGDUMP
	range 0 3600
	default 0
	help
	  Period in seconds of the periodic rewrite of the RKLOGDP1 header and
	  printk ring on the kpanic partition, used when the kernel command
	  line has no rklogdump_period=<sec>. 0 disables it.
```
